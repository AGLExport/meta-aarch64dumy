## conf/layer.conf
```bitbake
# We have a conf and classes directory, add to BBPATH
BBPATH .= ":${LAYERDIR}"

# We have a recipes-* directories, add to BBFILES
BBFILES += " \
	${LAYERDIR}/recipes-*/*/*.bb \
	${LAYERDIR}/recipes-*/*/*.bbappend \
"

BBFILE_COLLECTIONS += "aarch64dumy"
BBFILE_PATTERN_aarch64dumy = "^${LAYERDIR}/"
BBFILE_PRIORITY_aarch64dumy = "50"

LAYERSERIES_COMPAT_aarch64dumy = "rocko sumo thud warrior"
```

## conf/machine/aarch64dumy.conf
```bitbake
#@TYPE: Machine
#@NAME: aarch 64 dumy
#@DESCRIPTION: aarch 64 dumy BSP to use a container guest image

require conf/machine/include/tune-cortexa53.inc

DEFAULTTUNE = "cortexa53"

PREFERRED_PROVIDER_virtual/kernel ?= "linux-dummy"
PREFERRED_VERSION_linux-libc-headers ?= "4.14.%"

#PREFERRED_PROVIDER_virtual/xserver ?= "xserver-xorg"
#PREFERRED_PROVIDER_virtual/mesa ?= "mesa-gl"
#PREFERRED_PROVIDER_virtual/libgl ?= "mesa-gl"
```
